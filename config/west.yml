## config/west.yml
```yaml
manifest:
  remotes:
    - name: zmkfirmware 
      url-base: https://github.com/zmkfirmware
    - name: MeowCatpawkittie
      url-base: https://github.com/MeowCatpawkittie
    - name: caksoylar
      url-base: https://github.com/caksoylar
    - name: petejohanson
      url-base: https://github.com/petejohanson
    - name: mctechnology17
      url-base: https://github.com/mctechnology17
　projects:
    - name: zmk
      remote: zmkfirmware
      revision: main
      import: app/west.yml
    - name: cirque-input-module
      remote: petejohanson
      revision: main
    - name: zmk-rgbled-widget
      remote: caksoylar
      revision: main
    - name: zmk-oled-adapter
      remote: mctechnology17
      revision: main
    - name: zmk-nice-oled
      remote: mctechnology17
      revision: main  self:
    path: config
```
